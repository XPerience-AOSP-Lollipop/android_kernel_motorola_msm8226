## arch/arm/hotplug/Kconfig
```kconfig
config ALESSA_HOTPLUG
	bool "Enable Alessa_plug cpu hotplug driver"
	default y
	help
	    Generic alessa_plug cpu hotplug driver for ARM SOCs on the XPerience kernel
	    
config ALESSA_HOTPLUG_USE_CPU_UTIL
	bool "Enable Alessa_plug cpu statistics utilization"
	depends on (ALESSA_HOTPLUG)
	default y
	help
	  Alessa_plug cpu statistics utilization
```
